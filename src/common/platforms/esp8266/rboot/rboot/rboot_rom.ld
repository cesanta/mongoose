PROVIDE ( ets_delay_us = 0x40002ecc );
PROVIDE ( ets_memcpy = 0x400018b4 );
PROVIDE ( ets_memset = 0x400018a4 );
PROVIDE ( ets_printf = 0x400024cc );
PROVIDE ( SPIEraseSector = 0x40004a00 );
PROVIDE ( SPIRead = 0x40004b1c );
PROVIDE ( SPIWrite = 0x40004a4c );
PROVIDE ( uart_div_modify = 0x400039d8 );
