## tutorials/esp32/device-dashboard/sdkconfig.defaults
```kconfig
CONFIG_ESPTOOLPY_FLASHSIZE_4MB=y
CONFIG_ESPTOOLPY_FLASHSIZE="4MB"
CONFIG_PARTITION_TABLE_CUSTOM=y
CONFIG_PARTITION_TABLE_CUSTOM_FILENAME="partitions.csv"
CONFIG_PARTITION_TABLE_FILENAME="partitions.csv"
CONFIG_BOOTLOADER_APP_ROLLBACK_ENABLE=y
#CONFIG_ESP_MAIN_TASK_STACK_SIZE=8192
```

## tutorials/esp32/wifi-to-802.15.4-bridge/main/Kconfig.projbuild
```kconfig
menu "Wi-Fi to 802.15.4 bridge"
    config BRIDGE_XIAO_ESP32C6
        bool "Seeed XIAO ESP32-C6 antenna switch"
        default y
        help
            Power the RF switch through GPIO3 and select the antenna on GPIO14.
            Disable on boards without this switch.
    config BRIDGE_XIAO_EXTERNAL_ANTENNA
        bool "Use the XIAO's external antenna"
        depends on BRIDGE_XIAO_ESP32C6
        default n
    config BRIDGE_RADIO_CHANNEL
        int "802.15.4 channel, must match the radio nodes"
        range 11 26
        default 15
endmenu
```
